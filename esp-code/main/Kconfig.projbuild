## esp-code/main/Kconfig.projbuild
```kconfig
menu "Sampling configuration"

    config SAMPLING_FREQUENCY
        int "Set the default sampling frequency in Hz"
        range 1 1000
        default 1000
        help
            GPIO number (IOxx) to DS3231 SCL.
            Some GPIOs are used for other purposes (flash connections, etc.) and cannot be used to CS.
            GPIOs 35-39 are input-only so cannot be used as outputs.

    config FTT_ENABLED
        int "Decide to run or not the fft to adjust in an adaptive manner the sampling frequency"
        range 0 1
        default 1
        help
            GPIO number (IOxx) to DS3231 SDA.
            Some GPIOs are used for other purposes (flash connections, etc.) and cannot be used to DC.
            GPIOs 35-39 are input-only so cannot be used as outputs.

    config ENABLE_MQTT
        int "Decide to enable or not mqtt and the sending of a message"
        range 0 1
        default 1
        help 
            Select 1 to send messages to mqtt message broker
    
    config RTT_TIME_MEASUREMENT
        int "Decide if enable the round trip time measurement"
        range 0 1
        default 0
        help 
            If enabled a packet is sent over mqtt with the current time, so is possible to compute rtt in a server
    
    config ZSCORE_THRESHOLD
        int "Threshold value for the Z score, to identify outliers"
        range 0 10
        default 4
        help
            Your local timezone.
            When it is 0, Greenwich Mean Time.
    
    config MQTT_SERVER_ADDRESS
        string "Set the server address for mqtt"
        default "mqtt server address"
        help
            Insert the mqtt server address
    
    config MQTT_TOPIC
        string "Set the topic to where publish messages"
        default "frangella/individual/average"
        help
            Insert the topic

    config MQTT_USERNAME
        string "mqtt username to connect"
        default "username"
        help
            Insert the username

    config MQTT_PASSWORD
        string "Set the password to connect to mqtt server"
        default "password"
        help
            Insert the password

    config WIFI_SSID
        string "WIFI SSID"
        default "my wifi ssid"
        help
            Insert the wifi SSID that you want to use

    config WIFI_PASSKEY
        string "WIFI PASSWORD"
        default "password"
        help
            Insert the wifi Password
        
    

endmenu
```
